## conf/machine/orion-io.conf
```bitbake
#@TYPE: Machine
#@NAME: Orion I/O machine
#@DESCRIPTION: Machine configuration for Orion I/O

MACHINE_EXTRA_RRECOMMENDS = "\
    kernel-modules \
    kernel-devicetree \
    mmc-utils \
"

DEFAULTTUNE ?= "cortexa9thf-neon"
include conf/machine/include/tune-cortexa9.inc

IMAGE_FSTYPES += "tar.gz"

SERIAL_CONSOLE = "115200 ttymxc0"

PREFERRED_PROVIDER_virtual/kernel ?= "linux-yocto-rt"
PREFERRED_VERSION_linux-yocto-rt ?= "4.4%"

KERNEL_CLASSES += "kernel-fitimage"
KERNEL_IMAGETYPE = "fitImage"
KERNEL_DEVICETREE = "imx6sx-sdb-reva.dtb"
KERNEL_EXTRA_ARGS += "LOADADDR=0x80008000"

MACHINE_FEATURES = "usbhost vfat"

UBOOT_MACHINE = "mx6sxsabresd_spl_config"
UBOOT_SUFFIX = "img"
UBOOT_IMAGE = "u-boot-ivt-${MACHINE}-${PV}-${PR}.${UBOOT_SUFFIX}"
UBOOT_BINARY = "u-boot-ivt.${UBOOT_SUFFIX}"
UBOOT_SYMLINK = "u-boot-ivt-${MACHINE}.${UBOOT_SUFFIX}"
SPL_BINARY = "SPL"
UBOOT_ENTRYPOINT = "0x80008000"
UBOOT_LOADADDRESS = "0x80008000"
UBOOT_RD_ENTRYPOINT = "0x83800000"
UBOOT_RD_LOADADDRESS = "0x83800000"

IMAGE_BOOT_FILES = "fitImage-overlay-ima-initramfs-image-orion-io.bin"
```
